## arch/x86/Kconfig
```kconfig
config SKELETON_BUILD
	bool "Skeleton build for test"
	default n

source "core/Kconfig"

source "lib/Kconfig"
```

## core/Kconfig
```kconfig
#
# Core configuration
#

menu "Core Configurations"

config CORE_EMPTY
	bool "Import empty file for skeleton build"
	depends on SKELETON_BUILD
	default y

endmenu
```

## lib/Kconfig
```kconfig
#
# Library configuration
#

menu "Library routines"

config LIB_DUMMY
	bool "Import dummy file for skeleton build"
	depends on SKELETON_BUILD
	default y

endmenu
```
